## conf/layer.conf
```bitbake
# We have a conf and classes directory, add to BBPATH
BBPATH .= ":${LAYERDIR}"

# We have recipes-* directories, add to BBFILES
BBFILES += "${LAYERDIR}/recipes-*/*/*.bb \
            ${LAYERDIR}/recipes-*/*/*.bbappend"

BBFILE_COLLECTIONS += "wr-microchip-polarfire-soc"
BBFILE_PATTERN_wr-microchip-polarfire-soc = "^${LAYERDIR}/"
BBFILE_PRIORITY_wr-microchip-polarfire-soc = "7"

LAYERVERSION_wr-microchip-polarfire-soc = "1"
LAYERDEPENDS_wr-microchip-polarfire-soc = "core wrlinux"
LAYERSERIES_COMPAT_wr-microchip-polarfire-soc = "wrl scarthgap"

WRL_RECIPES:wr-microchip-polarfire-soc += "\
    hss-payload-generator \
    u-boot-mpfs \
    dt-overlay-mchp \
"
```

## conf/machine/include/mpfs-common-machine-configuration.inc
```bitbake
#@TYPE: Machine Include
#@SOC: Polarfire SoC
#@DESCRIPTION: Common Machine Configuration for Polarfire SoC

require conf/machine/include/riscv/tune-riscv.inc

MACHINE_FEATURES = "pci usbgadget ext2 ext3 serial"

KERNEL_CLASSES = "kernel-fitimage"
KERNEL_IMAGETYPE = "fitImage"
EXTERNAL_KERNEL_DEVICETREE = "${DEPLOY_DIR_IMAGE}/overlays"

RISCV_SBI_PLAT = "generic"

PREFERRED_PROVIDER_virtual/bootloader = "u-boot-mchp"
PREFERRED_PROVIDER_u-boot = "u-boot-mchp"

UBOOT_ENTRYPOINT = "0x80200000"
UBOOT_DTB_LOADADDRESS = "0x8a000000"
UBOOT_DTBO_LOADADDRESS = "0x8a080000"
UBOOT_RD_LOADADDRESS = "0x8aa00000"
UBOOT_RD_ENTRYPOINT = "0x8aa00000"

MACHINE_EXTRA_RRECOMMENDS += " kernel-modules"

IMAGE_FSTYPES += "wic wic.gz wic.bmap ext4"

IMAGE_INSTALL:append = " dt-overlay-mchp"

## wic default support
WKS_FILE_DEPENDS ?= " \
    e2fsprogs-native \
    bmaptool-native \
    u-boot-mchp \
"
```

## conf/machine/microchip-polarfire-soc.conf
```bitbake
#@TYPE: Machine
#@NAME: microchip-polarfire-soc
#@SOC: Polarfire SoC
#@DESCRIPTION: Machine configuration for the Microchip Polarfire SoC, Icicle Kit Engineering Sample

require include/mpfs-common-machine-configuration.inc

RISCV_SBI_FDT ?=  "mpfs-icicle-kit.dtb"
KERNEL_DTC_FLAGS += "-@"
KERNEL_DEVICETREE ?= "microchip/${RISCV_SBI_FDT}"

PREFERRED_PROVIDER_virtual/kernel ??= "linux-yocto"
PREFERRED_VERSION_linux-yocto ?= "6.6%"

## Set this to "mpfs_icicle" to use a nand flash as the default external flash memory
## Set this to "mpfs_icicle_nor" to use a nor flash as the default external flash memory
## Note: If no external flash memory is found, U-boot will try to boot from SD/emmc
## or fallback to tftp

UBOOT_CONFIG = "mpfs_icicle"
UBOOT_CONFIG[mpfs_icicle] = "microchip_mpfs_icicle_defconfig"

## Generate a boot.scr file which should be included
###  in the boot partition. It will try to load a kernel image from mmc
UBOOT_ENV = "boot"
UBOOT_ENV_SUFFIX = "scr"
UBOOT_ENV_SIZE = "0x2000"

HSS_PAYLOAD = "uboot"

IMAGE_BOOT_FILES ?= " \
    fitImage \
    boot.scr \
    uboot.env \
"

WKS_FILE ?= "mpfs-rootfs.wks"
```
